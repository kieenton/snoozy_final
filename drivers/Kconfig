## drivers/bno086/Kconfig
```kconfig
# Kconfig for BNO086 IMU driver

config BNO086
    bool "BNO086 IMU driver"
    depends on SPI
    depends on GPIO
    help
      Enable the BNO086 IMU driver.
```
